#include <LedControl.h>  
  
int DIN = 12;  
int CS =  11;  
int CLK = 10;  

byte ans[8][19];
byte num[10][8][4]={{{0,0,0,0},{1,1,1,0},{1,0,1,0},{1,0,1,0},{1,0,1,0},{1,0,1,0},{1,0,1,0},{1,1,1,0}},
                    {{0,0,0,0},{0,1,0,0},{1,1,0,0},{0,1,0,0},{0,1,0,0},{0,1,0,0},{0,1,0,0},{1,1,1,0}},
                    {{0,0,0,0},{1,1,1,0},{0,0,1,0},{0,0,1,0},{1,1,1,0},{1,0,0,0},{1,0,0,0},{1,1,1,0}},
                    {{0,0,0,0},{1,1,1,0},{0,0,1,0},{0,0,1,0},{1,1,1,0},{0,0,1,0},{0,0,1,0},{1,1,1,0}},
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                    {{0,0,0,0},{1,1,1,0},{1,0,1,0},{1,0,1,0},{1,1,1,0},{0,0,1,0},{0,0,1,0},{1,1,1,0}}
                    };
                    
byte ch[8][2]={{0,0},{0,0},{1,0},{1,0},{0,0},{1,0},{1,0},{0,0}};


LedControl lc=LedControl(DIN,CLK,CS,4);  
  
void setup(){  
 Serial.begin(9600);    
 delay(100);
 lc.shutdown(0,false);       //启动时，MAX72XX处于省电模式  
 lc.setIntensity(0,2);       //将亮度设置为合适的值(0-8）
 lc.clearDisplay(0);         //清除显示  
}  
  
void loop(){
  add(1,2,4,3);
  display(ans,19);
}  
  
//点阵显示函数  
void printByte(byte character [])  
{  
  int i = 0;  
  for(i=0;i<8;i++)  
  {  
    lc.setRow(0,i,character[i]);  
  }  
} 
 
//组合数字
void add(int a,int b,int c,int d) {
  for(int i=0;i<8;i++) {
    for(int j=0;j<4;j++) {
      ans[i][j]=num[a][i][j];
    }
    for(int j=0;j<4;j++) {
      ans[i][j+4]=num[b][i][j];
    }
    for(int j=0;j<2;j++) {
      ans[i][j+8]=ch[i][j];
    }
    for(int j=0;j<4;j++) {
      ans[i][j+10]=num[c][i][j];
    }
    for(int j=0;j<4;j++) {
      ans[i][j+14]=num[d][i][j];
    }
  }
}

//二进制转十进制
byte getNum(byte row[]) {
  int sum=0;
  for(int j=7;j>=0;j--){
      sum+=(row[7-j]<<j);
      Serial.println(sum);
  }
  return (byte)sum;
}

//滚动显示
void display(byte whole[][19], int n){
  byte img[8][8];
  for(int i=-8;i<n;i++){
    for(int j=0;j<8;j++) {
      if(i+j<0||i+j>=n) {
        for(int k=0;k<8;k++) {
          img[k][j]=0;
        }
      }
      else {
        for(int k=0;k<8;k++) {
          img[k][j]=whole[k][i+j];
        }
      }
    }
    byte ans[8];
    for(int k=0;k<8;k++) {
      ans[k]=getNum(img[k]);
    }
    printByte(ans);
    delay(100);
  }
}
